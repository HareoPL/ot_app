## main/Kconfig.projbuild
```kconfig
# menu "OpenThread device type"


# choice OPENTHREAD_DEVICE_TYPE
#     prompt "Choose device type"
#     default DT_CONTROLLER_OR_SENSOR

# config DT_BORDER_ROUTER
#     bool "Border Router"

# config DT_CONTROLLER_OR_SENSOR
#     bool "Controller/Sensor"

# config DT_CONTRO_PANEL
#     bool "Control Panel"

# endchoice

# config DEVICE_TYPE_ID
#     string
#     default "BR" if DT_BORDER_ROUTER
#     default "CS" if DT_CONTROLLER_OR_SENSOR
#     default "CP" if DT_CONTRO_PANEL



# endmenu

menu "Example Configuration"

    orsource "$IDF_PATH/examples/common_components/env_caps/$IDF_TARGET/Kconfig.env_caps"

    choice BLINK_LED
        prompt "Blink LED type"
        default BLINK_LED_GPIO
        help
            Select the LED type. A normal level controlled LED or an addressable LED strip.
            The default selection is based on the Espressif DevKit boards.
            You can change the default selection according to your board.

        config BLINK_LED_GPIO
            bool "GPIO"
        config BLINK_LED_STRIP
            bool "LED strip"
    endchoice

    choice BLINK_LED_STRIP_BACKEND
        depends on BLINK_LED_STRIP
        prompt "LED strip backend peripheral"
        default BLINK_LED_STRIP_BACKEND_RMT if SOC_RMT_SUPPORTED
        default BLINK_LED_STRIP_BACKEND_SPI
        help
            Select the backend peripheral to drive the LED strip.

        config BLINK_LED_STRIP_BACKEND_RMT
            depends on SOC_RMT_SUPPORTED
            bool "RMT"
        config BLINK_LED_STRIP_BACKEND_SPI
            bool "SPI"
    endchoice

    config BLINK_GPIO
        int "Blink GPIO number"
        range ENV_GPIO_RANGE_MIN ENV_GPIO_OUT_RANGE_MAX
        default 8
        help
            GPIO number (IOxx) to blink on and off the LED.
            Some GPIOs are used for other purposes (flash connections, etc.) and cannot be used to blink.

    config BLINK_PERIOD
        int "Blink period in ms"
        range 10 3600000
        default 1000
        help
            Define the blinking period in milliseconds.

endmenu
```
